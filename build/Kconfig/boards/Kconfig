## build/Kconfig/boards/Kconfig
```kconfig
# Load Zephyr board Kconfig descriptions.
osource "/home/raymond/zephyrproject/zephyr/boards/native/native_sim/Kconfig"
```

## build/Kconfig/boards/Kconfig.defconfig
```kconfig
# Load Zephyr board defconfig descriptions.
osource "/home/raymond/zephyrproject/zephyr/boards/native/native_sim/Kconfig.defconfig"
```

## build/Kconfig/boards/Kconfig.sysbuild
```kconfig
# Load Sysbuild board Kconfig descriptions.
osource "/home/raymond/zephyrproject/zephyr/boards/native/native_sim/Kconfig.sysbuild"
```
